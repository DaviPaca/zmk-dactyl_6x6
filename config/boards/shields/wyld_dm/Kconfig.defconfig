## config/boards/shields/wyld_dm/Kconfig.defconfig
```kconfig
if SHIELD_IANKY_DM_LEFT

config ZMK_KEYBOARD_NAME
    default "Ianky DM"

config ZMK_SPLIT_ROLE_CENTRAL
    default y

endif

if SHIELD_IANKY_DM_LEFT || SHIELD_IANKY_DM_RIGHT

config ZMK_SPLIT
    default y

endif
```

## config/boards/shields/wyld_dm/Kconfig.shield
```kconfig
# config SHIELD_IANKY_DM
#     bool

config SHIELD_IANKY_DM_LEFT
    def_bool $(shields_list_contains,ianky_dm_left)
#     select SHIELD_IANKY_DM

config SHIELD_IANKY_DM_RIGHT
    def_bool $(shields_list_contains,ianky_dm_right)
#     select SHIELD_IANKY_DM
```
